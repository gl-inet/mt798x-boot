/dts-v1/;
#include "gl-mt2500.dtsi"

&eth {
	status = "okay";
	mediatek,gmac-id = <0>;
	phy-mode = "sgmii";
	phy-handle = <&phy0>;
	reset-gpios = <&gpio 14 GPIO_ACTIVE_HIGH>;

	mdio {
		phy0: ethernet-phy@0 {
			reg = <0x5>;
		};
	};
};
